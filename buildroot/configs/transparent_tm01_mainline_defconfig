## buildroot/configs/transparent_tm01_mainline_defconfig
```kconfig
BR2_arm=y
BR2_cortex_a7=y
BR2_ARM_FPU_VFPV4=y
BR2_TOOLCHAIN_EXTERNAL=y
BR2_TARGET_GENERIC_HOSTNAME="transparent"
BR2_TARGET_GENERIC_ISSUE="Transparent Computer Co. TM01"
BR2_ROOTFS_DEVICE_CREATION_DYNAMIC_MDEV=y
BR2_TARGET_GENERIC_ROOT_PASSWD="123456"
BR2_ROOTFS_OVERLAY="board/allwinner-mainline/t113/rootfs board/transparent/tm01-mainline/rootfs"
BR2_ROOTFS_POST_BUILD_SCRIPT="board/allwinner-mainline/t113/scripts/post-build.sh"
BR2_ROOTFS_POST_IMAGE_SCRIPT="support/scripts/genimage.sh"
BR2_ROOTFS_POST_SCRIPT_ARGS="-c board/allwinner-mainline/t113/scripts/genimage_sdcard.cfg"
BR2_LINUX_KERNEL=y
#BR2_LINUX_KERNEL_CUSTOM_VERSION=y
#BR2_LINUX_KERNEL_CUSTOM_VERSION_VALUE="6.1.24"
BR2_LINUX_KERNEL_CUSTOM_TARBALL=y
BR2_LINUX_KERNEL_CUSTOM_TARBALL_LOCATION="https://github.com/smaeul/linux/archive/refs/heads/d1/all.tar.gz"
BR2_LINUX_KERNEL_PATCH="board/allwinner-mainline/t113/patches/linux/ board/transparent/tm01-mainline/patches/linux"
BR2_LINUX_KERNEL_USE_CUSTOM_CONFIG=y
BR2_LINUX_KERNEL_CUSTOM_CONFIG_FILE="board/transparent/tm01-mainline/configs/linux_defconfig"
BR2_LINUX_KERNEL_DTS_SUPPORT=y
BR2_LINUX_KERNEL_CUSTOM_DTS_PATH="board/allwinner-mainline/t113/devicetree/linux/sun8i-t113.dtsi board/transparent/tm01-mainline/devicetree/linux/sun8i-t113-transparent-tm01.dts"
BR2_PACKAGE_E2FSPROGS=y
BR2_PACKAGE_E2FSPROGS_RESIZE2FS=y
BR2_PACKAGE_FB_TEST_APP=y
BR2_PACKAGE_DROPBEAR=y
BR2_PACKAGE_IPERF3=y
#BR2_PACKAGE_NTP=y
BR2_PACKAGE_WPA_SUPPLICANT=y
BR2_PACKAGE_WPA_SUPPLICANT_CLI=y
BR2_PACKAGE_HTOP=y
BR2_TARGET_ROOTFS_EXT2=y
BR2_TARGET_ROOTFS_EXT2_4=y
BR2_TARGET_UBOOT=y
BR2_TARGET_UBOOT_BUILD_SYSTEM_KCONFIG=y
BR2_TARGET_UBOOT_CUSTOM_GIT=y
BR2_TARGET_UBOOT_CUSTOM_REPO_URL="https://github.com/apritzel/u-boot"
BR2_TARGET_UBOOT_CUSTOM_REPO_VERSION="t113s-mq-r-WIP"
BR2_TARGET_UBOOT_USE_CUSTOM_CONFIG=y
BR2_TARGET_UBOOT_CUSTOM_CONFIG_FILE="board/transparent/tm01-mainline/configs/uboot_defconfig"
BR2_TARGET_UBOOT_NEEDS_DTC=y
BR2_TARGET_UBOOT_NEEDS_PYLIBFDT=y
BR2_TARGET_UBOOT_SPL=y
BR2_TARGET_UBOOT_SPL_NAME="u-boot-sunxi-with-spl.bin"
BR2_TARGET_UBOOT_CUSTOM_DTS_PATH="board/allwinner-mainline/t113/devicetree/uboot/sun8i-t113s.dtsi board/allwinner-mainline/t113/devicetree/uboot/sunxi-d1-t113.dtsi board/allwinner-mainline/t113/devicetree/uboot/sunxi-d1s-t113.dtsi board/transparent/tm01-mainline/devicetree/uboot/sun8i-t113-transparent-tm01.dts"
BR2_PACKAGE_HOST_GENIMAGE=y
BR2_PACKAGE_HOST_MTOOLS=y
BR2_PACKAGE_HOST_PYTHON3=y
BR2_PACKAGE_HOST_UBOOT_TOOLS=y

BR2_TARGET_ROOTFS_EXT2_SIZE="256M"

BR2_PACKAGE_ALSA_UTILS=y
BR2_PACKAGE_ALSA_UTILS_AMIXER=y
BR2_PACKAGE_ALSA_UTILS_APLAY=y

BR2_PACKAGE_LINUX_FIRMWARE=y
BR2_PACKAGE_LINUX_FIRMWARE_REDPINE_RS9116=y

BR2_PACKAGE_IW=y

BR2_PACKAGE_WPA_SUPPLICANT_AP_SUPPORT=y
BR2_PACKAGE_WPA_SUPPLICANT_WIFI_DISPLAY=y

BR2_INIT_SYSTEMD=y

BR2_PACKAGE_BASH=y

BR2_PACKAGE_GSTREAMER1=y
BR2_PACKAGE_GST1_PLUGINS_BASE=y
BR2_PACKAGE_GST1_PLUGINS_GOOD=y
BR2_PACKAGE_GST1_PLUGINS_BAD=y
BR2_PACKAGE_GST1_PLUGINS_UGLY=y
BR2_PACKAGE_GST1_LIBAV=y

BR2_PACKAGE_GST1_PLUGINS_GOOD_PLUGIN_UDP=y
BR2_PACKAGE_GST1_PLUGINS_GOOD_PLUGIN_RTPMANAGER=y
BR2_PACKAGE_GST1_PLUGINS_GOOD_PLUGIN_RTP=y
BR2_PACKAGE_GST1_PLUGINS_BAD_PLUGIN_MPEGTSDEMUX=y
BR2_PACKAGE_GST1_PLUGINS_BAD_PLUGIN_VIDEOPARSERS=y
BR2_PACKAGE_GST1_PLUGINS_GOOD_PLUGIN_AUTODETECT=y
BR2_PACKAGE_GST1_PLUGINS_BAD_PLUGIN_KMS=y

BR2_PACKAGE_GST1_PLUGINS_BASE_PLUGIN_VIDEOCONVERT=y
BR2_PACKAGE_GST1_PLUGINS_BASE_PLUGIN_VIDEOSCALE=y

BR2_PACKAGE_GST1_PLUGINS_BAD_PLUGIN_V4L2CODECS=y

BR2_PACKAGE_MIRACLECAST=y

BR2_PACKAGE_PSPLASH=y
BR2_PACKAGE_PSPLASH_IMAGE="psplash.png"

BR2_PACKAGE_TCPDUMP=y
```
